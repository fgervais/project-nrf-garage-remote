## CMakeLists.txt
```
list(APPEND OVERLAY_CONFIG "coap-server.conf")
list(APPEND OVERLAY_CONFIG "secret.conf")
list(APPEND OVERLAY_CONFIG "thread-ftd.conf")

cmake_minimum_required(VERSION 3.20.0)
list(APPEND BOARD_ROOT ${CMAKE_CURRENT_SOURCE_DIR})
find_package(Zephyr REQUIRED HINTS $ENV{ZEPHYR_BASE})

execute_process(COMMAND git describe
                WORKING_DIRECTORY ${CMAKE_CURRENT_SOURCE_DIR}
                OUTPUT_VARIABLE GIT_DESCRIBE
                ERROR_QUIET)
string(STRIP "${GIT_DESCRIBE}" GIT_DESCRIBE)
STRING(REGEX MATCH "[0-9]+\\.[0-9]+\\.[0-9]+"
       VERSION "${GIT_DESCRIBE}")

project(app LANGUAGES C VERSION ${VERSION})


configure_file(app_version.h.in ${CMAKE_BINARY_DIR}/app/include/app_version.h)
zephyr_include_directories(
        ${CMAKE_BINARY_DIR}/app/include
)
target_include_directories(app PRIVATE ${CMAKE_BINARY_DIR}/app/include src)

zephyr_include_directories(
       configuration/${BOARD})

target_sources(app PRIVATE
        src/door.c
        src/main.c)

zephyr_linker_sources(DATA_SECTIONS sections-ram.ld)

zephyr_iterable_section(
        NAME coap_resource_coap_server
        GROUP DATA_REGION ${XIP_ALIGN_WITH_INPUT}
        SUBALIGN CONFIG_LINKER_ITERABLE_SUBALIGN)
```

## prj.conf
```kconfig
CONFIG_SERIAL=y
CONFIG_HEAP_MEM_POOL_SIZE=2048

CONFIG_PM_DEVICE=y

CONFIG_CAF=y
CONFIG_CAF_BUTTONS=y
CONFIG_CAF_BUTTONS_POLARITY_INVERSED=y

CONFIG_MY_MODULE_BASE_RESET=y
CONFIG_MY_MODULE_BASE_WATCHDOG=y
CONFIG_MY_MODULE_BASE_WATCHDOG_TIMEOUT_SEC=30

#CONFIG_MAIN_STACK_SIZE=4096
#CONFIG_SYSTEM_WORKQUEUE_STACK_SIZE=2048
CONFIG_LOG_BUFFER_SIZE=16384

CONFIG_THREAD_NAME=y
CONFIG_EVENTS=y
CONFIG_CONSOLE=y
CONFIG_UART_CONSOLE=y

CONFIG_THREAD_ANALYZER=y
CONFIG_LOG_SPEED=y
CONFIG_LOG=y
```

## coap-server.conf
```kconfig
CONFIG_COAP=y
CONFIG_COAP_SERVER=y

CONFIG_NET_UDP=y
```

## thread-ftd.conf
```kconfig
# CONFIG_NEWLIB_LIBC_NANO is not set
CONFIG_NEWLIB_LIBC_MIN_REQUIRED_HEAP_SIZE=2048

CONFIG_MY_MODULE_BASE_OPENTHREAD=y

CONFIG_OPENTHREAD_CHANNEL=15
CONFIG_OPENTHREAD_NETWORK_NAME="home"
CONFIG_OPENTHREAD_PANID=8768
CONFIG_OPENTHREAD_XPANID="42:24:00:00:00:00:10:00"


#CONFIG_OPENTHREAD_CHANNEL=20
#CONFIG_OPENTHREAD_NETWORK_NAME="debug"
#CONFIG_OPENTHREAD_PANID=1234
#CONFIG_OPENTHREAD_XPANID="AA:BB:CC:DD:AA:BB:CC:DD"

#CONFIG_OPENTHREAD_SETTINGS_RAM=y
# CONFIG_OPENTHREAD_L2_DEBUG=y
CONFIG_OPENTHREAD_DEBUG=y
CONFIG_OPENTHREAD_LOG_LEVEL_DEBG=y
CONFIG_OPENTHREAD_L2_LOG_LEVEL_DBG=y
CONFIG_NET_IPV6_LOG_LEVEL_DBG=y
CONFIG_NET_IF_LOG_LEVEL_DBG=y
```

## boards/pink_panda.overlay
```dts
&gpio0 {
	status = "okay";
};
&gpiote {
    status = "okay";
};
&ieee802154 {
	status = "okay";
};
```

## src/main.c
```c
#include <app_event_manager.h>
#include <zephyr/drivers/gpio.h>
#include <zephyr/drivers/watchdog.h>
#include <zephyr/kernel.h>
#include <zephyr/net/coap_service.h>
#include <zephyr/net/net_if.h>
#include <zephyr/pm/device.h>
#include <zephyr/sys/reboot.h>
#include <zephyr/debug/thread_analyzer.h>

#define MODULE main
#include <caf/events/module_state_event.h>
#include <caf/events/button_event.h>

#include <zephyr/logging/log.h>
LOG_MODULE_REGISTER(main, LOG_LEVEL_DBG);

#include <app_version.h>
#include <mymodule/base/openthread.h>
#include <mymodule/base/reset.h>
#include <mymodule/base/watchdog.h>

#include "door.h"

#define BUTTON_PRESS_EVENT		BIT(0)
#define MANUAL_REBOOT_TOKEN		(uint8_t)0x38

#define ALL_NODES_LOCAL_COAP_MCAST                                                                 \
	{                                                                                          \
		{                                                                                  \
			{                                                                          \
				0xff, 0x02, 0, 0, 0, 0, 0, 0, 0, 0, 0, 0, 0, 0, 0, 0xfd            \
			}                                                                          \
		}                                                                                  \
	}

static K_EVENT_DEFINE(button_events);

static const uint16_t coap_port = 5683;
COAP_SERVICE_DEFINE(coap_server, NULL, &coap_port, 0);

static const struct gpio_dt_spec power_led = GPIO_DT_SPEC_GET(DT_ALIAS(led1), gpios);
static const struct gpio_dt_spec initialized_led = GPIO_DT_SPEC_GET(DT_ALIAS(led0), gpios);

int join_coap_multicast_group(void)
{
	struct in6_addr mcast_addr6 = ALL_NODES_LOCAL_COAP_MCAST;
	struct net_if_mcast_addr *mcast;
	struct net_if *iface;

	LOG_INF("joining the COAP multicast group");

	iface = net_if_get_default();
	if (!iface) {
		LOG_ERR("Could not get the default interface");
		return -ENOENT;
	}

	mcast = net_if_ipv6_maddr_add(iface, &mcast_addr6);
	if (!mcast) {
		LOG_ERR("Could not add multicast address to interface");
		return -ENOENT;
	}

	return 0;
}

int main(void)
{
	const struct device *wdt = DEVICE_DT_GET(DT_NODELABEL(wdt0));
#if defined(CONFIG_APP_SUSPEND_CONSOLE)
	const struct device *cons = DEVICE_DT_GET(DT_CHOSEN(zephyr_console));
#endif
	int ret;
	uint32_t reset_cause;
	int main_wdt_chan_id = -1;
	uint32_t events;

	ret = watchdog_new_channel(wdt, &main_wdt_chan_id);
	if (ret < 0) {
		LOG_ERR("Could allocate main watchdog channel");
		return ret;
	}

	ret = watchdog_start(wdt);
	if (ret < 0) {
		LOG_ERR("Could allocate start watchdog");
		return ret;
	}

	LOG_INF("\n\n🚀 MAIN START (%s) 🚀\n", APP_VERSION_FULL);

	reset_cause = show_and_clear_reset_cause();

	if (is_reset_cause_watchdog(reset_cause)
	    || is_reset_cause_button(reset_cause)) {
		ret = openthread_erase_persistent_info();
		if (ret < 0) {
			LOG_WRN("Could not erase openthread info");
		}
		else {
			k_sleep(K_SECONDS(3));
			sys_reboot(MANUAL_REBOOT_TOKEN);
		}
	}

	if (!gpio_is_ready_dt(&power_led)) {
		return -EIO;
	}

	ret = gpio_pin_configure_dt(&power_led, GPIO_OUTPUT_ACTIVE);
	if (ret < 0) {
		return ret;
	}

	if (!gpio_is_ready_dt(&initialized_led)) {
		return -EIO;
	}

	ret = gpio_pin_configure_dt(&initialized_led, GPIO_OUTPUT_INACTIVE);
	if (ret < 0) {
		return ret;
	}

	if (app_event_manager_init()) {
		LOG_ERR("Event manager not initialized");
	} else {
		module_set_state(MODULE_STATE_READY);
	}

	ret = openthread_my_start();
	if (ret < 0) {
		LOG_ERR("Could not start openthread");
		return ret;
	}

	LOG_INF("💤 waiting for openthread to be ready");
	openthread_wait(OT_ROLE_SET | OT_MESH_LOCAL_ADDR_SET);

	ret = join_coap_multicast_group();
	if (ret < 0) {
		LOG_ERR("Could not join the COAP multicast group");
		return ret;
	}

	LOG_INF("starting the COAP service");
	ret = door_init();
	if (ret < 0) {
		LOG_ERR("Could not init door module");
		return ret;
	}
	ret = coap_service_start(&coap_server);
	if (ret < 0) {
		LOG_ERR("Could not start COAP service");
		return ret;
	}

	ret = gpio_pin_set_dt(&initialized_led, 1);
	if (ret < 0) {
		LOG_ERR("Could not set initialized led");
	}

	LOG_INF("🆗 initialized");

#if defined(CONFIG_APP_SUSPEND_CONSOLE)
	ret = pm_device_action_run(cons, PM_DEVICE_ACTION_SUSPEND);
	if (ret < 0) {
		LOG_ERR("Could not suspend the console");
		return ret;
	}
#endif

	thread_analyzer_print();

	LOG_INF("┌──────────────────────────────────────────────────────────┐");
	LOG_INF("│ Entering main loop                                       │");
	LOG_INF("└──────────────────────────────────────────────────────────┘");

	while (1) {
		LOG_INF("💤 waiting for events");
		events = k_event_wait(&button_events, (BUTTON_PRESS_EVENT), true,
				      K_SECONDS(CONFIG_APP_MAIN_LOOP_PERIOD_SEC));

		LOG_INF("⏰ events: %08x", events);

		if (events & BUTTON_PRESS_EVENT) {
			LOG_INF("handling button press event");
		}

		LOG_INF("🦴 feed watchdog");
		wdt_feed(wdt, main_wdt_chan_id);
	}

	return 0;
}

static bool event_handler(const struct app_event_header *eh)
{
	const struct button_event *evt;

	if (is_button_event(eh)) {
		evt = cast_button_event(eh);

		if (evt->pressed) {
			LOG_INF("🛎️  Button pressed");
			k_event_post(&button_events, BUTTON_PRESS_EVENT);
		}
	}

	return true;
}

APP_EVENT_LISTENER(MODULE, event_handler);
APP_EVENT_SUBSCRIBE(MODULE, button_event);
```

## src/door.c
```c
#include <zephyr/drivers/gpio.h>
#include <zephyr/kernel.h>
#include <zephyr/net/coap_service.h>

#include <zephyr/logging/log.h>
LOG_MODULE_REGISTER(door_coap_service, LOG_LEVEL_DBG);

#include <stdio.h>

struct request {
	struct sockaddr addr;
	uint16_t id;
	k_timepoint_t timeout;
};

static struct request m_requests[CONFIG_COAP_SERVICE_PENDING_MESSAGES];

static const struct gpio_dt_spec door_led = GPIO_DT_SPEC_GET(DT_ALIAS(led2), gpios);

static int get_free_request(struct request **request)
{
	int i;

	for (i = 0; i < ARRAY_SIZE(m_requests); i++) {
		if (sys_timepoint_expired(m_requests[i].timeout)) {
			LOG_DBG("found a free request at index = %d", i);
			*request = &m_requests[i];
			return 0;
		}
	}

	LOG_ERR("no free requests");
	return -ENOMEM;
}

static bool is_request_answered(struct sockaddr *addr, uint16_t id)
{
	int i;
	const struct sockaddr_in6 *a6;
	const struct sockaddr_in6 *b6;

	for (i = 0; i < ARRAY_SIZE(m_requests); i++) {
		a6 = net_sin6(addr);
		b6 = net_sin6(&m_requests[i].addr);

		if (a6->sin6_port != b6->sin6_port ||
		    !net_ipv6_addr_cmp(&a6->sin6_addr, &b6->sin6_addr) ||
		    m_requests[i].id != id ||
		    sys_timepoint_expired(m_requests[i].timeout)) {
			continue;
		}

		LOG_DBG("request already answered at index = %d", i);
		return true;
	}

	LOG_INF("📨 request not yet answered");
	return false;
}

static int set_request_answered(struct sockaddr *addr, uint16_t id)
{
	int ret;
	struct request *request = NULL;

	ret = get_free_request(&request);
	if (ret < 0) {
		return ret;
	}

	net_ipaddr_copy(&request->addr, addr);
	request->id = id;
	request->timeout = sys_timepoint_calc(K_MSEC(CONFIG_COAP_INIT_ACK_TIMEOUT_MS * 3));

	LOG_DBG("request answered set");

	return 0;
}

static int door_get(struct coap_resource *resource, struct coap_packet *request,
		    struct sockaddr *addr, socklen_t addr_len)
{
	uint8_t data[CONFIG_COAP_SERVER_MESSAGE_SIZE];
	struct coap_packet response;
	uint8_t payload[40];
	uint8_t token[COAP_TOKEN_MAX_LEN];
	uint16_t id;
	uint8_t code;
	uint8_t type;
	uint8_t token_length;
	int ret;

	code = coap_header_get_code(request);
	type = coap_header_get_type(request);
	id = coap_header_get_id(request);
	token_length = coap_header_get_token(request, token);

	LOG_INF("📬 GET (door)");
	LOG_INF("└── type: %u code %u id %u", type, code, id);

	if (is_request_answered(addr, id)) {
		LOG_INF("↩️  request already answered, skipping");
		return 0;
	}

	if (type == COAP_TYPE_CON) {
		type = COAP_TYPE_ACK;
	} else {
		type = COAP_TYPE_NON_CON;
	}

	ret = coap_packet_init(&response, data, sizeof(data), COAP_VERSION_1, type, token_length,
			     token, COAP_RESPONSE_CODE_CONTENT, id);
	if (ret < 0) {
		return ret;
	}

	ret = coap_append_option_int(&response, COAP_OPTION_CONTENT_FORMAT,
				   COAP_CONTENT_FORMAT_TEXT_PLAIN);
	if (ret < 0) {
		return ret;
	}

	ret = coap_packet_append_payload_marker(&response);
	if (ret < 0) {
		return ret;
	}

	ret = snprintf(payload, sizeof(payload), "Type: %u\nCode: %u\nMID: %u\n", type, code, id);
	if (ret < 0) {
		return ret;
	}

	ret = coap_packet_append_payload(&response, (uint8_t *)payload, strlen(payload));
	if (ret < 0) {
		return ret;
	}

	ret = coap_resource_send(resource, &response, addr, addr_len, NULL);
	if (ret < 0) {
		return ret;
	}

	ret = set_request_answered(addr, id);
	if (ret < 0) {
		LOG_ERR("could not set request as answered");
	}

	return 0;
}

static int door_post(struct coap_resource *resource, struct coap_packet *request,
		     struct sockaddr *addr, socklen_t addr_len)
{
	uint8_t data[CONFIG_COAP_SERVER_MESSAGE_SIZE];
	struct coap_packet response;
	uint8_t token[COAP_TOKEN_MAX_LEN];
	const uint8_t *payload;
	uint16_t payload_len;
	uint8_t code;
	uint8_t type;
	uint8_t token_length;
	uint16_t id;
	int ret;

	code = coap_header_get_code(request);
	type = coap_header_get_type(request);
	id = coap_header_get_id(request);
	token_length = coap_header_get_token(request, token);

	LOG_INF("📬 POST (door)");
	LOG_INF("└── type: %u code %u id %u", type, code, id);

	if (!is_request_answered(addr, id)) {
		LOG_INF("🧪  serving request");

		ret = gpio_pin_toggle_dt(&door_led);
		if (ret < 0) {
			LOG_ERR("Could not toggle door led");
		}
	}
	else {
		LOG_INF("ℹ️  request already answered");
	}

	payload = coap_packet_get_payload(request, &payload_len);
	if (payload) {
		LOG_HEXDUMP_INF(payload, payload_len, "POST Payload");
	}

	if (type == COAP_TYPE_CON) {
		type = COAP_TYPE_ACK;
	} else {
		type = COAP_TYPE_NON_CON;
	}

	ret = coap_packet_init(&response, data, sizeof(data), COAP_VERSION_1, type, token_length,
			       token, COAP_RESPONSE_CODE_CHANGED, id);
	if (ret < 0) {
		return ret;
	}

	ret = coap_resource_send(resource, &response, addr, addr_len, NULL);
	if (ret < 0) {
		return ret;
	}

	ret = set_request_answered(addr, id);
	if (ret < 0) {
		LOG_ERR("could not set request as answered");
	}

	return 0;
}

int door_init(void)
{
	int ret;

	if (!gpio_is_ready_dt(&door_led)) {
		return -EIO;
	}

	ret = gpio_pin_configure_dt(&door_led, GPIO_OUTPUT_INACTIVE);
	if (ret < 0) {
		return ret;
	}

	return 0;
}

static const char *const door_path[] = {"door", NULL};
COAP_RESOURCE_DEFINE(door, coap_server,
		     {
			     .get = door_get,
			     .post = door_post,
			     .path = door_path,
		     });
```

## src/door.h
```c
#ifndef DOOR_H_
#define DOOR_H_

int door_init(void);

#endif /* DOOR_H_ */
```
